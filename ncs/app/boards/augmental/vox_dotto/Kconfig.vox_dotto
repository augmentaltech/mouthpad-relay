## ncs/app/boards/augmental/vox_dotto/Kconfig.vox_dotto
```kconfig
# Augmental Vox (Dotto) board
# SPDX-License-Identifier: Apache-2.0

config BOARD_VOX_DOTTO
	select SOC_NRF52840_QIAA
	select SOC_SERIES_NRF52X
```

## ncs/app/boards/augmental/vox_dotto/board.yml
```yaml
board:
  name: vox_dotto
  full_name: Augmental Vox (Dotto 610-00006-1)
  vendor: augmental
  socs:
  - name: nrf52840
```
